## kernel-3.18/drivers/cci/Kconfig
```kconfig
#
# Compalcomm drivers
#

menuconfig CCI_DRIVERS
        tristate "Compalcomm drivers for CY33."
        default y

if CCI_DRIVERS

#[CY33] ==> CCI KLog, added by Joker@CCI
source "drivers/cci/klog/Kconfig"
#[CY33] <== CCI KLog, added by Joker@CCI

endif
```

## kernel-3.18/drivers/misc/mediatek/accelerometer/stk8313/Kconfig
```kconfig
config MTK_STK8313
       bool "STK8313 for Mediatek package"
	default n
	help
	  It support different accelerometer sensor.
          If this option is set,
	  it will support
          STK8313 Accelerometer.
```

## kernel-3.18/drivers/misc/mediatek/alsps/stk3x1x-3311/Kconfig
```kconfig
config MTK_STK3X1X_3311
	bool "stk3x1x-3311 for MediaTek package"
	default n
	help
	It support different type sensor
	in this platform. If this option
	is set, it will support ambient
	and light sensor stk3x1x-3311.
```

## kernel-3.18/drivers/misc/mediatek/cam_cal/Kconfig
```kconfig
config MTK_CAM_CAL
  bool CONFIG_MTK_CAM_CAL
  default n
  help
    CONFIG_MTK_CAM_CAL define if the camera cal driver should be built in or not

#
# Camera EEPROM Calibration
#
config MTK_CAM_CAL_GT24C64A_SUPPORT
       bool "GT24C64A EEPROM Driver"
       default n

#
# Camera EEPROM Calibration
#
config MTK_CAM_CAL_ZC533_SUPPORT
       bool "ZC533 EEPROM Driver"
       default n
```
